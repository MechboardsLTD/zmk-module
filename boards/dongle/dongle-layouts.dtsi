#include <physical_layouts.dtsi>

/ {
    physical_layout0: physical_layout_0 {
        compatible = "zmk,physical-layout";
        display-name = "One Key";

        keys  //                     w   h    x    y     rot    rx    ry
            = <&key_physical_attrs 100 100  500    0       0     0     0>
            ;
    };
};