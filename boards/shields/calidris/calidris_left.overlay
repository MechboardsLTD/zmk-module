#include "calidris.dtsi" // Notice that the main dtsi files are included in the overlay.

&kscan0 {
    col-gpios
        = <&gpio0 29 GPIO_ACTIVE_HIGH> // col5 in the schematic
        , <&gpio0 2 GPIO_ACTIVE_HIGH> // col4 in the schematic
        , <&gpio1 15 GPIO_ACTIVE_HIGH> // col3 in the schematic
        , <&gpio1 13 GPIO_ACTIVE_HIGH>  // col2 in the schematic
        , <&gpio1 11 GPIO_ACTIVE_HIGH>  // col1 in the schematic
        ;
};