#include "calidris.dtsi"

&default_transform { // The right half starts at column 5.
    col-offset = <5>;
};

&kscan0 {
    col-gpios
        = <&gpio1 11 GPIO_ACTIVE_HIGH> 
        , <&gpio1 13 GPIO_ACTIVE_HIGH> 
        , <&gpio1 15 GPIO_ACTIVE_HIGH>
        , <&gpio0 2 GPIO_ACTIVE_HIGH>
        , <&gpio0 29 GPIO_ACTIVE_HIGH>
        ;
};
