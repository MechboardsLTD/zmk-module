## boards/arm/corne_min/Kconfig
```kconfig
config BOARD_ENABLE_DCDC
    bool "Enable DCDC mode"
    select SOC_DCDC_NRF52X
    default y
    depends on (BOARD_CORNE_MIN_LEFT || BOARD_CORNE_MIN_RIGHT)
```

## boards/arm/corne_min/Kconfig.board
```kconfig
#
# Copyright (c) 2025 Mechboards LTD
# SPDX-License-Identifier: MIT
#

config BOARD_CORNE_MIN_LEFT
	bool "corne_min_left"
	depends on SOC_NRF52840_QIAA

config BOARD_CORNE_MIN_RIGHT
	bool "corne_min_right"
	depends on SOC_NRF52840_QIAA
```

## boards/arm/corne_min/Kconfig.defconfig
```kconfig
if BOARD_CORNE_MIN_LEFT

config ZMK_KEYBOARD_NAME
	default "Corne Min"

config ZMK_SPLIT_ROLE_CENTRAL
	default y

endif # BOARD_CORNE_MIN_LEFT


if BOARD_CORNE_MIN_LEFT || BOARD_CORNE_MIN_RIGHT

config BOARD
	default "corne_min"

config ZMK_SPLIT
	default y

config BT_CTLR
	default BT

if USB_DEVICE_STACK

config USB_NRFX
	default y

endif # USB_DEVICE_STACK

endif # BOARD_CORNE_MIN_LEFT || BOARD_CORNE_MIN_RIGHT
```

## boards/shields/calidris/Kconfig.defconfig
```kconfig
if SHIELD_CALIDRIS_LEFT

config ZMK_KEYBOARD_NAME
    default "Calidris"

config ZMK_SPLIT_ROLE_CENTRAL
    default y

endif

if SHIELD_CALIDRIS_LEFT || SHIELD_CALIDRIS_RIGHT

config ZMK_SPLIT
    default y

endif
```

## boards/shields/calidris/Kconfig.shield
```kconfig
config SHIELD_CALIDRIS_LEFT
    def_bool $(shields_list_contains,calidris_left)

config SHIELD_CALIDRIS_RIGHT
    def_bool $(shields_list_contains,calidris_right)
```

## boards/shields/totem/Kconfig.defconfig
```kconfig
if SHIELD_TOTEM_LEFT

# Name has to be fewer than 16 characters long
config ZMK_KEYBOARD_NAME
    default "TOTEM"

config ZMK_SPLIT_ROLE_CENTRAL
    default y

endif

if SHIELD_TOTEM_LEFT || SHIELD_TOTEM_RIGHT

config ZMK_SPLIT
    default y

endif
```

## boards/shields/twenty5/Kconfig.defconfig
```kconfig
if SHIELD_TWENTY5

# Name must be less than 16 characters long!
config ZMK_KEYBOARD_NAME
    default "Twenty5"

endif
```

## boards/shields/twenty5/Kconfig.shield
```kconfig
# No whitespace after the comma or in your keyboard name!
config SHIELD_TWENTY5
    def_bool $(shields_list_contains,twenty5)
    
```
