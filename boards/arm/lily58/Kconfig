## boards/arm/lily58/Kconfig
```kconfig
config BOARD_ENABLE_DCDC
    bool "Enable DCDC mode"
    select SOC_DCDC_NRF52X
    default y
    depends on (BOARD_LILY58_LEFT || BOARD_LILY58_RIGHT)
```

## boards/arm/lily58/Kconfig.board
```kconfig
#
# Copyright (c) 2025 Mechboards LTD
# SPDX-License-Identifier: MIT
#

config BOARD_LILY58_LEFT
	bool "lily58_left"
	depends on SOC_NRF52840_QIAA

config BOARD_LILY58_RIGHT
	bool "lily58_right"
	depends on SOC_NRF52840_QIAA
```

## boards/arm/lily58/Kconfig.defconfig
```kconfig
if BOARD_LILY58_LEFT

config ZMK_KEYBOARD_NAME
	default "Lily58 R2G W"

config ZMK_SPLIT_ROLE_CENTRAL
	default y

endif # BOARD_LILY58_LEFT


if BOARD_LILY58_LEFT || BOARD_LILY58_RIGHT

config BOARD
	default "lily58"

config ZMK_SPLIT
	default y

config BT_CTLR
	default BT

if USB_DEVICE_STACK

config USB_NRFX
	default y

endif # USB_DEVICE_STACK

endif # BOARD_LILY58_LEFT || BOARD_LILY58_RIGHT
```

## boards/dongle/Kconfig.defconfig
```kconfig
# Copyright (c) 2020 The ZMK Contributors
# SPDX-License-Identifier: MIT

if BOARD_DONGLE

config BOARD
    default "dongle"

config ZMK_KEYBOARD_NAME
    default "MB Dongle"
     
if USB_DEVICE_STACK

config USB_NRFX
    default y

endif # USB_DEVICE_STACK
    
endif # BOARD_DONGLE
```

## boards/ll66/Kconfig.defconfig
```kconfig
# Copyright (c) 2020 The ZMK Contributors
# SPDX-License-Identifier: MIT

if BOARD_LL66

config BOARD
    default "ll66"

config ZMK_KEYBOARD_NAME
    default "LL66"
     
if USB_DEVICE_STACK

config USB_NRFX
    default y

endif # USB_DEVICE_STACK

config BT_CTLR
    default BT
    
endif # BOARD_LL66
```

## boards/merzigo/Kconfig.defconfig
```kconfig
# Copyright (c) 2020 The ZMK Contributors
# SPDX-License-Identifier: MIT

if BOARD_PAD

config BOARD
    default "pad"

config ZMK_KEYBOARD_NAME
    default "Merzigo Pad"
     
if USB_DEVICE_STACK

config USB_NRFX
    default y

endif # USB_DEVICE_STACK

config BT_CTLR
    default BT
    
endif # BOARD_PAD
```

## boards/merzigo/pad_defconfig
```kconfig
# SPDX-License-Identifier: MIT

# Enable MPU
CONFIG_ARM_MPU=y

# Use pinctrl
CONFIG_PINCTRL=y

# enable GPIO
CONFIG_GPIO=y

CONFIG_USE_DT_CODE_PARTITION=y
CONFIG_BUILD_OUTPUT_UF2=y

CONFIG_MPU_ALLOW_FLASH_WRITE=y
CONFIG_NVS=y
CONFIG_SETTINGS_NVS=y
CONFIG_FLASH=y
CONFIG_FLASH_PAGE_LAYOUT=y
CONFIG_FLASH_MAP=y

CONFIG_ZMK_BLE=y
CONFIG_ZMK_USB=y

CONFIG_EC11=y
CONFIG_EC11_TRIGGER_GLOBAL_THREAD=y
CONFIG_NFCT_PINS_AS_GPIOS=y

CONFIG_ZMK_SLEEP=y
CONFIG_ZMK_IDLE_SLEEP_TIMEOUT=1800000

CONFIG_RGBLED_WIDGET_CONN_BLINK_MS=60000
CONFIG_RGBLED_WIDGET_BATTERY_BLINK_MS=5000
CONFIG_RGBLED_WIDGET_CONN_SHOW_USB=y
CONFIG_RGBLED_WIDGET_CONN_COLOR_USB=5

CONFIG_ZMK_BLE_EXPERIMENTAL_CONN=y
CONFIG_BT_CTLR_TX_PWR_PLUS_8=y
```

## boards/shields/micropad/Kconfig.defconfig
```kconfig
# Copyright (c) 2026
# SPDX-License-Identifier: MIT

if SHIELD_MICROPAD

config ZMK_KEYBOARD_NAME
    default "Micro Pad"

endif
```

## boards/sixbysix/Kconfig.defconfig
```kconfig
# Copyright (c) 2020 The ZMK Contributors
# SPDX-License-Identifier: MIT

if BOARD_SIXBYSIX

config BOARD
    default "sixbysix"

config ZMK_KEYBOARD_NAME
    default "Mechboards 6x6"
     
if USB_DEVICE_STACK

config USB_NRFX
    default y

endif # USB_DEVICE_STACK

config BT_CTLR
    default BT
    
endif # BOARD_SIXBYSIX
```
